#include "file_browser.h"
#include "odroid_display.h"
#include "bsp/m5stack_tab5.h"
#include "cjk_font16.h"
#include "esp_log.h"
#include "esp_timer.h"
#include "esp_vfs_fat.h"
#include "freertos/FreeRTOS.h"
#include "freertos/task.h"
#include <dirent.h>
#include <string.h>
#include <stdlib.h>
#include <sys/stat.h>

static const char *TAG = "file_browser";
#pragma GCC diagnostic push
#pragma GCC diagnostic ignored "-Wformat-truncation"

#define MAX_FILES       256
#define MAX_PATH        512
#define ROW_HEIGHT      26
#define TITLE_H         30
#define SCREEN_W        320
#define SCREEN_H        240

/* Colors (RGB565) — tuned to match the UserDemo SD browser look. */
#define COLOR_BG        0x10A2   /* near-black list background       */
#define COLOR_TITLE_BG  0x2945   /* dark gray header                 */
#define COLOR_TITLE_FG  0xFFFF
#define COLOR_ROW_BG    0x10A2
#define COLOR_ROW_ALT   0x18E3   /* zebra striping for readability   */
#define COLOR_ROW_SEL   0x4208   /* pressed/selected row highlight   */
#define COLOR_ROW_FG    0xFFFF
#define COLOR_DIR_FG    0xFDE3   /* folder = amber (demo 0xFDBE1A)   */
#define COLOR_FILE_FG   0x469F   /* file   = cyan  (demo 0x43D2FF)   */
#define COLOR_SCROLLBAR 0x52AA
#define COLOR_SCROLLTRK 0x18E3

typedef struct {
    char name[128];
    char full_path[MAX_PATH];
    int  name_len;
    bool is_dir;
} file_entry_t;

static file_entry_t s_files[MAX_FILES];
static int s_file_count = 0;
static int s_scroll_offset = 0;
static int s_selected = 0;
static char s_current_path[MAX_PATH];
static bool s_running = false;
static uint16_t *s_fb = NULL;

#include <stdint.h>
static const uint8_t font_8x16[95][16] = {
    {0x00,0x00,0x00,0x00,0x00,0x00,0x00,0x00,0x00,0x00,0x00,0x00,0x00,0x00,0x00,0x00},
    {0x00,0x00,0x18,0x3C,0x3C,0x3C,0x18,0x18,0x18,0x00,0x18,0x18,0x00,0x00,0x00,0x00},
    {0x00,0x66,0x66,0x66,0x24,0x00,0x00,0x00,0x00,0x00,0x00,0x00,0x00,0x00,0x00,0x00},
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    {0x00,0x00,0x76,0xDC,0x00,0x00,0x00,0x00,0x00,0x00,0x00,0x00,0x00,0x00,0x00,0x00},
};

static void draw_char(int x, int y, char c, uint16_t fg, uint16_t bg)
{
    if (c < 32 || c > 126) c = ' ';
    int idx = c - 32;
    uint16_t *fb = s_fb;
    for (int row = 0; row < 16; row++) {
        uint8_t bits = font_8x16[idx][row];
        for (int col = 0; col < 8; col++) {
            int px = x + col;
            int py = y + row;
            if (px < 0 || px >= SCREEN_W || py < 0 || py >= SCREEN_H) continue;
            fb[py * SCREEN_W + px] = (bits & (0x80 >> col)) ? fg : bg;
        }
    }
}

/* Draw a 16x16 CJK glyph (codepoint cp) at (x,y). Falls back to a hollow box
 * if the glyph isn't in the GB2312 font. */
static void draw_cjk(int x, int y, uint32_t cp, uint16_t fg, uint16_t bg)
{
    const uint8_t *g = cjk_glyph(cp);
    for (int row = 0; row < 16; row++) {
        uint16_t bits = g ? ((g[row * 2] << 8) | g[row * 2 + 1]) : 0;
        for (int col = 0; col < 16; col++) {
            int px = x + col, py = y + row;
            if (px < 0 || px >= SCREEN_W || py < 0 || py >= SCREEN_H) continue;
            s_fb[py * SCREEN_W + px] = (bits & (0x8000 >> col)) ? fg : bg;
        }
    }
}

/* Decode one UTF-8 codepoint; returns pointer past the consumed bytes. */
static const char *utf8_next(const char *s, uint32_t *cp)
{
    unsigned char c = (unsigned char)s[0];
    if (c < 0x80) { *cp = c; return s + 1; }
    if ((c >> 5) == 0x6 && (s[1] & 0xc0) == 0x80) {
        *cp = ((c & 0x1f) << 6) | (s[1] & 0x3f);
        return s + 2;
    }
    if ((c >> 4) == 0xe && (s[1] & 0xc0) == 0x80 && (s[2] & 0xc0) == 0x80) {
        *cp = ((c & 0x0f) << 12) | ((s[1] & 0x3f) << 6) | (s[2] & 0x3f);
        return s + 3;
    }
    if ((c >> 3) == 0x1e && (s[1] & 0xc0) == 0x80 && (s[2] & 0xc0) == 0x80 && (s[3] & 0xc0) == 0x80) {
        *cp = ((c & 0x07) << 18) | ((s[1] & 0x3f) << 12) | ((s[2] & 0x3f) << 6) | (s[3] & 0x3f);
        return s + 4;
    }
    *cp = c;            /* invalid byte: render as-is, advance 1 */
    return s + 1;
}

/* UTF-8 aware string draw: ASCII glyphs are 8px wide, CJK glyphs 16px.
 * max_chars limits the number of glyphs drawn (0 = no limit). */
static void draw_string(int x, int y, const char *str, uint16_t fg, uint16_t bg, int max_chars)
{
    int cx = x;
    int count = 0;
    while (*str && (max_chars == 0 || count < max_chars)) {
        uint32_t cp;
        str = utf8_next(str, &cp);
        if (cp < 0x80) {
            draw_char(cx, y, (char)cp, fg, bg);
            cx += 8;
        } else {
            draw_cjk(cx, y, cp, fg, bg);
            cx += 16;
        }
        count++;
        if (cx >= SCREEN_W) break;
    }
}

/* Display width in pixels (ASCII=8, CJK=16). */
static int str_disp_width(const char *str)
{
    int w = 0;
    uint32_t cp;
    while (*str) { str = utf8_next(str, &cp); w += (cp < 0x80) ? 8 : 16; }
    return w;
}

static void draw_string_centered(int y, const char *str, uint16_t fg, uint16_t bg)
{
    int x = (SCREEN_W - str_disp_width(str)) / 2;
    if (x < 0) x = 0;
    draw_string(x, y, str, fg, bg, 0);
}

static void fill_rect(int x, int y, int w, int h, uint16_t color)
{
    if (x < 0) { w += x; x = 0; }
    if (y < 0) { h += y; y = 0; }
    if (x + w > SCREEN_W) w = SCREEN_W - x;
    if (y + h > SCREEN_H) h = SCREEN_H - y;
    if (w <= 0 || h <= 0) return;
    for (int row = 0; row < h; row++) {
        for (int col = 0; col < w; col++) {
            s_fb[(y + row) * SCREEN_W + (x + col)] = color;
        }
    }
}

static int compare_entries(const void *a, const void *b)
{
    const file_entry_t *fa = (const file_entry_t *)a;
    const file_entry_t *fb = (const file_entry_t *)b;
    if (fa->is_dir && !fb->is_dir) return -1;
    if (!fa->is_dir && fb->is_dir) return 1;
    return strcasecmp(fa->name, fb->name);
}

static int scan_directory(const char *path)
{
    DIR *dir = opendir(path);
    if (!dir) {
        ESP_LOGE(TAG, "Cannot open dir: %s", path);
        return 0;
    }

    int count = 0;
    int seen = 0;
    struct dirent *entry;
    while ((entry = readdir(dir)) != NULL && count < MAX_FILES) {
        if (strcmp(entry->d_name, ".") == 0) continue;

        char full[MAX_PATH];
        snprintf(full, sizeof(full), "%s/%s", path, entry->d_name);

        struct stat st;
        int strc = stat(full, &st);
        ESP_LOGD(TAG, "entry[%d]: '%s' stat=%d", seen++, entry->d_name, strc);
        if (strc != 0) continue;

        file_entry_t *fe = &s_files[count];
        snprintf(fe->name, sizeof(fe->name), "%s", entry->d_name);
        snprintf(fe->full_path, sizeof(fe->full_path), "%s", full);
        fe->name_len = strlen(fe->name);
        fe->is_dir = S_ISDIR(st.st_mode);

        if (fe->is_dir) {
            if (strcmp(entry->d_name, "..") == 0) {
                fe->name[0] = '.';
                fe->name[1] = '.';
                fe->name[2] = '\0';
                count++;
            } else {
                count++;
            }
        } else {
            const char *ext = strrchr(entry->d_name, '.');
            if (ext && (strcasecmp(ext, ".rom") == 0 || strcasecmp(ext, ".nand") == 0)) {
                count++;
            }
        }
    }
    closedir(dir);

    qsort(s_files, count, sizeof(file_entry_t), compare_entries);

    /* Prepend a synthetic ".." entry (unless at the SD root) so the user can
     * always tap to go up one directory. */
    if (strcmp(path, "/sd") != 0 && count < MAX_FILES) {
        memmove(&s_files[1], &s_files[0], (size_t)count * sizeof(file_entry_t));
        file_entry_t *up = &s_files[0];
        snprintf(up->name, sizeof(up->name), "..");
        up->name_len = 2;
        up->is_dir   = true;
        up->full_path[0] = '\0';
        count++;
    }

    ESP_LOGI(TAG, "scan: %d entries in %s", count, path);
    return count;
}

/* ── small 14×11 folder / file icons drawn with rects ─────────────── */
static void draw_folder_icon(int x, int y, uint16_t c, uint16_t bg)
{
    (void)bg;
    fill_rect(x,     y + 1, 6, 2,  c);   /* tab            */
    fill_rect(x,     y + 3, 14, 8, c);   /* body           */
}
static void draw_file_icon(int x, int y, uint16_t c, uint16_t bg)
{
    fill_rect(x + 1, y,     9, 11, c);   /* page           */
    fill_rect(x + 7, y,     3, 3,  bg);  /* folded corner  */
    fill_rect(x + 8, y + 1, 2, 2,  c);
}

static void draw_ui(void)
{
    /* Clear the whole 320×240 buffer first (shared with the emulator). */
    fill_rect(0, 0, SCREEN_W, SCREEN_H, COLOR_BG);

    int visible_rows = (SCREEN_H - TITLE_H) / ROW_HEIGHT;
    int list_h       = visible_rows * ROW_HEIGHT;

    /* ── Header: current path (right-aligned to last segment) + item count ── */
    fill_rect(0, 0, SCREEN_W, TITLE_H, COLOR_TITLE_BG);
    const char *shown = s_current_path;
    if (str_disp_width(shown) > (SCREEN_W - 60)) {        /* keep the tail visible */
        const char *slash = strrchr(s_current_path, '/');
        if (slash && slash != s_current_path) shown = slash;
    }
    draw_string(4, 3, shown, COLOR_TITLE_FG, COLOR_TITLE_BG, 0);
    char info[20];
    snprintf(info, sizeof(info), "%d", s_file_count);
    draw_string(SCREEN_W - 4 - (int)strlen(info) * 8, 3, info, COLOR_DIR_FG, COLOR_TITLE_BG, 0);
    draw_string(4, 16, "drag=scroll  tap=open  top=up", 0x8410, COLOR_TITLE_BG, 0);

    /* ── File rows ── */
    for (int i = 0; i < visible_rows; i++) {
        int idx = s_scroll_offset + i;
        int y   = TITLE_H + i * ROW_HEIGHT;
        if (idx >= s_file_count) break;
        file_entry_t *fe = &s_files[idx];

        uint16_t bg = (idx == s_selected) ? COLOR_ROW_SEL
                                          : ((i & 1) ? COLOR_ROW_ALT : COLOR_ROW_BG);
        fill_rect(0, y, SCREEN_W - 5, ROW_HEIGHT, bg);

        int ty = y + (ROW_HEIGHT - 16) / 2;   /* vertically center the 16px text */
        if (fe->is_dir) {
            if (strcmp(fe->name, "..") == 0) {
                draw_string(6, ty, "<", COLOR_DIR_FG, bg, 0);
                draw_string(26, ty, "(up one level)", COLOR_DIR_FG, bg, 0);
            } else {
                draw_folder_icon(6, y + (ROW_HEIGHT - 11) / 2, COLOR_DIR_FG, bg);
                draw_string(26, ty, fe->name, COLOR_DIR_FG, bg, 35);
            }
        } else {
            draw_file_icon(6, y + (ROW_HEIGHT - 11) / 2, COLOR_FILE_FG, bg);
            draw_string(26, ty, fe->name, COLOR_FILE_FG, bg, 35);
        }
    }

    /* ── Scrollbar (indicator only; scrolling is by drag) ── */
    fill_rect(SCREEN_W - 5, TITLE_H, 5, list_h, COLOR_SCROLLTRK);
    if (s_file_count > visible_rows) {
        int bar_h = (visible_rows * list_h) / s_file_count;
        if (bar_h < 10) bar_h = 10;
        int span  = list_h - bar_h;
        int bar_y = TITLE_H + (s_scroll_offset * span) / (s_file_count - visible_rows);
        fill_rect(SCREEN_W - 5, bar_y, 5, bar_h, COLOR_SCROLLBAR);
    }

    /* The odroid emu flush rotates 270°, but the emulator UI uses 90° — so the
     * browser came out upside-down. Rotate the framebuffer 180° (== reverse the
     * pixel array) before flushing so 270°+180° = 90°, matching the emulator. */
    int total = SCREEN_W * SCREEN_H;
    for (int i = 0, j = total - 1; i < j; i++, j--) {
        uint16_t t = s_fb[i]; s_fb[i] = s_fb[j]; s_fb[j] = t;
    }

    display_emu_flush();
}

/* Drag-to-scroll state */
static bool s_touching     = false;
static int  s_press_uy     = 0;   /* UI y at touch-down            */
static int  s_press_scroll = 0;   /* scroll offset at touch-down   */
static bool s_dragged      = false;

/* Touch→UI mapping. The 320×240 UI is scaled 3× and rotated 270° by PPA, then
 * drawn at panel offset (0, FB_Y_OFF) on the 720×1280 panel. Touch reports raw
 * panel coords; map them back to UI space. If taps land on the wrong row/axis,
 * tweak here — every tap logs its raw coords for calibration. */
#define FB_Y_OFF  160   /* (1280 - 960) / 2 */
#define FB_SCALE  3
static inline void touch_to_ui(uint16_t px, uint16_t py, int *ux, int *uy)
{
    *ux = ((int)py - FB_Y_OFF) / FB_SCALE;   /* -> 0..320 */
    *uy = (719 - (int)px) / FB_SCALE;        /* -> 0..240 */
    /* Match the 180° framebuffer rotation applied in draw_ui(). */
    *ux = (SCREEN_W - 1) - *ux;
    *uy = (SCREEN_H - 1) - *uy;
}

static void rescan(void)
{
    s_file_count    = scan_directory(s_current_path);
    s_scroll_offset = 0;
    s_selected      = -1;   /* no persistent cursor; tap opens directly */
}

static void go_up(void)
{
    if (strcmp(s_current_path, "/sd") == 0) return;   /* already at root */
    char *slash = strrchr(s_current_path, '/');
    if (slash && slash != s_current_path) {
        *slash = '\0';
        if (strlen(s_current_path) < 3) {
            snprintf(s_current_path, sizeof(s_current_path), "/sd");
        }
        rescan();
    }
}

static void activate_index(int idx)
{
    if (idx < 0 || idx >= s_file_count) return;
    file_entry_t *fe = &s_files[idx];
    if (fe->is_dir) {
        if (strcmp(fe->name, "..") == 0) {
            go_up();
        } else {
            snprintf(s_current_path, sizeof(s_current_path), "%s", fe->full_path);
            rescan();
        }
    } else {
        s_selected = idx;
        s_running  = false;   /* exit run loop → main() launches the ROM */
    }
}

/* Drag to scroll, tap (press+release without much movement) to open/select.
 * Tapping the header strip goes up one directory. */
static void handle_touch(void)
{
    uint16_t px = 0, py = 0;
    bool pressed = bsp_touch_read(&px, &py);

    int visible_rows = (SCREEN_H - TITLE_H) / ROW_HEIGHT;
    int max_off = (s_file_count > visible_rows) ? (s_file_count - visible_rows) : 0;

    if (pressed) {
        int ux, uy;
        touch_to_ui(px, py, &ux, &uy);
        (void)ux;
        if (!s_touching) {                 /* press edge */
            ESP_LOGW(TAG, "PRESS raw px=%u py=%u -> ux=%d uy=%d", px, py, ux, uy);
            s_touching     = true;
            s_dragged      = false;
            s_press_uy     = uy;
            s_press_scroll = s_scroll_offset;
        } else {                           /* held → drag-scroll */
            int dy = uy - s_press_uy;
            if (dy > 6 || dy < -6) s_dragged = true;
            if (s_dragged) {
                int off = s_press_scroll - dy / ROW_HEIGHT;
                if (off < 0) off = 0;
                if (off > max_off) off = max_off;
                s_scroll_offset = off;
            }
        }
    } else {
        if (s_touching && !s_dragged) {    /* release without drag = tap */
            if (s_press_uy < TITLE_H) {
                ESP_LOGW(TAG, "TAP uy=%d -> go_up", s_press_uy);
                go_up();
            } else {
                int idx = s_press_scroll + (s_press_uy - TITLE_H) / ROW_HEIGHT;
                ESP_LOGW(TAG, "TAP uy=%d -> idx=%d (count=%d)", s_press_uy, idx, s_file_count);
                activate_index(idx);
            }
        } else if (s_touching) {
            ESP_LOGW(TAG, "release: dragged, no tap");
        }
        s_touching = false;
    }
}

esp_err_t file_browser_init(const char *base_path)
{
    snprintf(s_current_path, sizeof(s_current_path), "%s", base_path);
    s_file_count = scan_directory(s_current_path);
    s_scroll_offset = 0;
    s_selected = -1;
    ESP_LOGI(TAG, "Found %d files in %s", s_file_count, s_current_path);
    return ESP_OK;
}

int file_browser_run(char *selected_path, int max_len)
{
    /* Render into the shared 320×240 emulator buffer (matches SCREEN_W stride)
     * and present via the emu flush, so the browser fills the panel exactly
     * like the games do. (Previously used the 800×480 main framebuffer with a
     * 320 stride, which squished the UI into a tiny strip.) */
    s_fb = display_get_emu_buffer();
    if (!s_fb) {
        ESP_LOGE(TAG, "No framebuffer!");
        return -1;
    }

    s_running = true;
    while (s_running) {
        draw_ui();
        handle_touch();
        vTaskDelay(pdMS_TO_TICKS(30));
    }

    if (s_selected >= 0 && s_selected < s_file_count && !s_files[s_selected].is_dir) {
        snprintf(selected_path, max_len, "%s", s_files[s_selected].full_path);
        return 0;
    }
    return -1;
}

void file_browser_deinit(void)
{
    s_running = false;
}

#pragma GCC diagnostic pop
